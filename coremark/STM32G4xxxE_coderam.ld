MEMORY
{
  FLASH (rx) :    ORIGIN = 0x08000000, LENGTH = 512K
  ITCRAM (xrw) :  ORIGIN = 0x10000000, LENGTH = 32K
  RAM (xrw) :     ORIGIN = 0x20000000, LENGTH = 96K    
}

REGION_ALIAS("CODERAM", ITCRAM);
REGION_ALIAS("DTCRAM", RAM);
REGION_ALIAS("RAM2", RAM);

INCLUDE nvcm_default_coderam.ld
