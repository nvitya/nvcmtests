MEMORY
{
  FLASH (rx)     :  ORIGIN = 0x08000000, LENGTH = 64K
  CODERAM (xrw)  :  ORIGIN = 0x1FFF0000, LENGTH = 64K
  RAM (xrw)      :  ORIGIN = 0x20000000, LENGTH = 64K
}

REGION_ALIAS("ITCRAM", CODERAM);
REGION_ALIAS("DTCRAM", RAM);
REGION_ALIAS("RAM2", RAM);

INCLUDE nvcm_default_coderam.ld
